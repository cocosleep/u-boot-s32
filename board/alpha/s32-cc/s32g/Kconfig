## board/alpha/s32-cc/s32g/Kconfig
```kconfig
config ALPHA_S32G_ALPHA_BOARD
	bool
	default n
	imply BOARD_LATE_INIT
	imply CMD_PMIC
	imply DM_PMIC
	imply DM_PMIC_FS5600
	imply DM_PMIC_PF5020
	imply DM_PMIC_VR5510
	imply ALPHA_S32CC_BOARD_COMMON
	imply PHY_MICREL
	imply PHY_MICREL_KSZ90X1
	select ADC
	select DM_REGULATOR
	select OF_BOARD_SETUP
	select SARADC_S32CC
	select SPI_FLASH_MACRONIX
	select SPI_FLASH_MX25UW51245G
	select SPI_FLASH_SOFT_RESET
	select SPI_FLASH_SOFT_RESET_ON_BOOT
```

## configs/s32g399a_alpha_defconfig
```kconfig
CONFIG_ARM=y
CONFIG_ARCH_S32G3=y
CONFIG_OF_BOARD_SETUP=y
CONFIG_TARGET_S32G399AALPHA=y
CONFIG_SD_BOOT=y
CONFIG_USE_BOOTARGS=y
CONFIG_ARCH_EARLY_INIT_R=y
CONFIG_BOARD_LATE_INIT=y
CONFIG_CMD_CPU=y
CONFIG_CMD_MD5SUM=y
CONFIG_MD5SUM_VERIFY=y
CONFIG_CMD_ADC=y
CONFIG_CMD_CLK=y
CONFIG_CMD_DM=y
CONFIG_CMD_FUSE=y
CONFIG_CMD_GPIO=y
CONFIG_CMD_I2C=y
CONFIG_CMD_MMC=y
CONFIG_CMD_MMC_REG=y
CONFIG_CMD_PCI=y
CONFIG_CMD_SPI=y
CONFIG_CMD_CACHE=y
CONFIG_CMD_TIME=y
CONFIG_CMD_TIMER=y
CONFIG_CMD_PMIC=y
CONFIG_CMD_SMC=y
CONFIG_SARADC_S32CC=y
CONFIG_SPI_FLASH_SOFT_RESET=y
CONFIG_SPI_FLASH_SOFT_RESET_ON_BOOT=y
CONFIG_SPI_FLASH_MACRONIX=y
CONFIG_SPI_FLASH_MX25UW51245G=y
CONFIG_PHY_MICREL=y
CONFIG_PHY_MICREL_KSZ90X1=y
CONFIG_CMD_E1000=y
CONFIG_DM_PMIC=y
CONFIG_DM_PMIC_FS5600=y
CONFIG_DM_PMIC_PF5020=y
CONFIG_DM_PMIC_VR5510=y
CONFIG_DM_REGULATOR=y
```
